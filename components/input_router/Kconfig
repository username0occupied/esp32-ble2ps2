## components/input_router/Kconfig
```kconfig
menu "Input Router"

choice INPUT_ROUTER_SWITCH_STRATEGY
    prompt "PC Switch Strategy"
    default INPUT_ROUTER_SWITCH_KEYBOARD_PAGE
    help
        Select which hotkeys are intercepted to switch active PC output target.

    config INPUT_ROUTER_SWITCH_KEYBOARD_PAGE
        bool "Keyboard PageUp/PageDown"
        help
            PageUp switches to PC1 and PageDown switches to PC2.
            The hotkeys are intercepted and not forwarded to PS/2.

    config INPUT_ROUTER_SWITCH_MOUSE_SIDE
        bool "Mouse side buttons (Forward/Back)"
        help
            Mouse side Forward button (b5) switches to PC1 and
            Back button (b4) switches to PC2.
            Side-button hotkeys are intercepted and not forwarded to PS/2.
endchoice

config INPUT_ROUTER_MAGIC_TEXT
    string "Repeated side-button output text"
    depends on INPUT_ROUTER_SWITCH_MOUSE_SIDE
    default ""
    help
        Text sent via keyboard when pressing the side-button hotkey
        for the already-active target PC.
        Leave empty to disable this output.

endmenu
```

## sdkconfig.defaults
```kconfig
CONFIG_IDF_TARGET="esp32c3"

CONFIG_BT_ENABLED=y
CONFIG_BT_BLUEDROID_ENABLED=y
CONFIG_BT_NIMBLE_ENABLED=n
CONFIG_BT_HID_HOST_ENABLED=y
CONFIG_BT_BLE_ENABLED=y
CONFIG_BT_CLASSIC_ENABLED=n
CONFIG_BT_BLE_42_FEATURES_SUPPORTED=y
CONFIG_BT_BLE_42_ADV_EN=y
CONFIG_BT_BLE_42_SCAN_EN=y
CONFIG_BT_GATTC_NOTIF_REG_MAX=16

CONFIG_FREERTOS_HZ=1000
```
